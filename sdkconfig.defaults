## sdkconfig.defaults
```kconfig
# Long filename support — needed for timestamped WAV files
CONFIG_FATFS_LFN_HEAP=y
CONFIG_FATFS_MAX_LFN=64

# Relax WDT timeouts for SD card operations
CONFIG_ESP_TASK_WDT_TIMEOUT_S=10
CONFIG_ESP_INT_WDT_TIMEOUT_MS=800
```
